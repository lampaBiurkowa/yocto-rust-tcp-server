## meta-custom-tcp/conf/layer.conf
```bitbake
# We have a conf and classes directory, add to BBPATH
BBPATH .= ":${LAYERDIR}"

# We have recipes-* directories, add to BBFILES
BBFILES += "${LAYERDIR}/recipes-*/*/*.bb \
            ${LAYERDIR}/recipes-*/*/*.bbappend"

BBFILE_COLLECTIONS += "meta-custom-tcp"
BBFILE_PATTERN_meta-custom-tcp = "^${LAYERDIR}/"
BBFILE_PRIORITY_meta-custom-tcp = "6"

LAYERDEPENDS_meta-custom-tcp = "core"
LAYERSERIES_COMPAT_meta-custom-tcp = "mickledore scarthgap"
```
